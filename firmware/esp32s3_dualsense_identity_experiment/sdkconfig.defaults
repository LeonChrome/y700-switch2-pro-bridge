## firmware/esp32s3_dualsense_identity_experiment/sdkconfig.defaults
```kconfig
CONFIG_IDF_TARGET="esp32s3"
CONFIG_ESPTOOLPY_FLASHSIZE_16MB=y
CONFIG_FREERTOS_HZ=1000
CONFIG_LOG_DEFAULT_LEVEL_INFO=y
CONFIG_TINYUSB_HID_COUNT=1
CONFIG_TINYUSB_VENDOR_COUNT=0
```
